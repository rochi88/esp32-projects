## zephyr/boards/espressif/esp32c3_supermini/Kconfig.esp32c3_supermini
```kconfig
# Copyright 2022 Google LLC
# SPDX-License-Identifier: Apache-2.0

config BOARD_ESP32C3_SUPERMINI
	select SOC_ESP32C3_FN4
```
