## CMakeLists.txt
```
# SPDX-License-Identifier: Apache-2.0
cmake_minimum_required(VERSION 3.20.0)

find_package(Zephyr REQUIRED HINTS $ENV{ZEPHYR_BASE})
set(app esp32_devkitc_wroom)
project(${app})

if(SSID)
    message(STATUS "Found SSID")
else()
    message(SEND_ERROR "SSID not found")
endif()

if(PSK)
    message(STATUS "Found PSK")
else()
    message(SEND_ERROR "PSK not found")
endif()

include(${CMAKE_SOURCE_DIR}/cmake/cmake-git-version-tracking.cmake)

FILE(GLOB ${app}_sources src/*.c)

target_sources(app PRIVATE ${${app}_sources})
target_link_libraries(app PRIVATE cmake_git_version_tracking)
target_compile_definitions(app PRIVATE -D__APP_NAME__=\"${app}\" -DSSID=\"${SSID}\" -DPSK=\"${PSK}\")
```

## Kconfig
```
mainmenu "ESP32 Wifi application"

config NET_SAMPLE_NUM_HANDLERS
    int "How many connections to serve at the same time"
    default 1
    help
      Each connection is served by a thread which needs
      memory. Only increase the value here if really needed.

source "Kconfig.zephyr"
```

## sample.yaml
```
common:
  harness: net
  tags:
    - net
    - wifi
sample:
  description: Connect to Wifi network with ESP32
  name: ESP32 WiFi
```

## prj.conf
```kconfig
CONFIG_EARLY_CONSOLE=y

CONFIG_WIFI=y
CONFIG_WIFI_LOG_LEVEL_DBG=y

CONFIG_NETWORKING=y
# CONFIG_MAIN_STACK_SIZE=4096
CONFIG_ENTROPY_GENERATOR=y
CONFIG_TEST_RANDOM_GENERATOR=y
CONFIG_INIT_STACKS=y
CONFIG_DYNAMIC_THREAD_STACK_SIZE=2048
CONFIG_DYNAMIC_THREAD=y
CONFIG_THREAD_STACK_INFO=y

# DHCP
CONFIG_NET_DHCPV4=y
CONFIG_ESP32_WIFI_STA_AUTO_DHCPV4=y

# Static IPV4
# CONFIG_NET_CONFIG_SETTINGS=y
# CONFIG_NET_CONFIG_NEED_IPV4=y
# CONFIG_NET_CONFIG_MY_IPV4_ADDR="192.168.1.11"
# CONFIG_NET_CONFIG_MY_IPV4_GW="192.168.1.1"

# CONFIG_OBJ_CORE=y
# CONFIG_NET_SOCKETS_OBJ_CORE=y
# CONFIG_NET_TCP_LOG_LEVEL_DBG=y

CONFIG_NET_IPV4=y
CONFIG_NET_UDP=y
CONFIG_NET_TCP=y
CONFIG_NET_LOG=y
CONFIG_NET_STATISTICS=y
CONFIG_NET_STATISTICS_PERIODIC_OUTPUT=n
CONFIG_NET_CONNECTION_MANAGER=y
CONFIG_NET_SOCKETS=y
CONFIG_NET_SOCKETS_POSIX_NAMES=y
CONFIG_NET_TX_STACK_SIZE=2048
CONFIG_NET_RX_STACK_SIZE=2048
CONFIG_NET_PKT_RX_COUNT=10
CONFIG_NET_PKT_TX_COUNT=10
CONFIG_NET_BUF_RX_COUNT=20
CONFIG_NET_BUF_TX_COUNT=20
CONFIG_NET_MAX_CONTEXTS=10
CONFIG_NET_L2_WIFI_SHELL=y
CONFIG_NET_SHELL=y
CONFIG_NET_HOSTNAME_ENABLE=y
CONFIG_NET_HOSTNAME_UNIQUE=n
CONFIG_NET_HOSTNAME="esp32"

CONFIG_MDNS_RESPONDER=y
CONFIG_DNS_SD=y
CONFIG_MDNS_RESPONDER_DNS_SD=y

CONFIG_POSIX_MAX_FDS=6
# Number of socket descriptors might need adjusting
# if there are more than 1 handlers defined.
CONFIG_POSIX_MAX_FDS=12

# How many client can connect to server simultaneously
CONFIG_NET_SAMPLE_NUM_HANDLERS=1
```

## boards/esp32_devkitc_wroom.conf
```kconfig
CONFIG_WIFI=y
CONFIG_HEAP_MEM_POOL_SIZE=98304

CONFIG_NETWORKING=y
CONFIG_NET_L2_ETHERNET=y

CONFIG_NET_IPV6=n
CONFIG_NET_IPV4=y
CONFIG_NET_LOG=y
```

## src/main.c
```c
/*
 * SPDX-License-Identifier: Apache-2.0
 */
#include <zephyr/kernel.h>
#include <stddef.h>

#include "version.h"
#include "wifi.h"
#include "server.h"

/************************************ DEFINES **********************************/
#define SERVER_TL_TYPE SERVER_PROTO_TCP
#define SERVER_PORT 4242
#define REGISTER_SERVICE true
#define SERVER_STACK_SIZE 4000

#if defined(CONFIG_NET_TC_THREAD_COOPERATIVE)
#define SERVER_THREAD_PRIO K_PRIO_COOP(CONFIG_NUM_COOP_PRIORITIES - 1)
#else
#define SERVER_THREAD_PRIO K_PRIO_PREEMPT(8)
#endif

/************************************* DATA ***********************************/
static k_tid_t server_tid;
static K_THREAD_STACK_DEFINE(server_stack, SERVER_STACK_SIZE);
static struct k_thread server_td;

/******************************* MAIN ENTRY POINT *****************************/
int main(void)
{
    wifi_iface_t *wifi = NULL;
    server_t *server = NULL;

    version_print();

    /* Connect to Wifi */
    wifi = wifi_get();
    wifi->connect(SSID, PSK);
    wifi->status();

    /* Create server context */
    server = server_new(SERVER_TL_TYPE, SERVER_PORT, REGISTER_SERVICE);

    /* Spawn server */
    server_tid = k_thread_create(&server_td, server_stack,
                 K_THREAD_STACK_SIZEOF(server_stack),
                 server_start, server, NULL, NULL, SERVER_THREAD_PRIO, 0,
                 K_NO_WAIT);

    for (;;)
        k_sleep(K_MSEC(100));

    return 0;
}
```

## src/server.c
```c
/******************************** INCLUDE FILES *******************************/
#include <zephyr/net/socket.h>
#include <zephyr/kernel.h>
#include <errno.h>
#include <stdio.h>
#include <assert.h>
#include <zephyr/logging/log.h>
#include <zephyr/net/dns_sd.h>

#include "server.h"

/******************************** LOCAL DEFINES *******************************/
LOG_MODULE_REGISTER(server, LOG_LEVEL_DBG);
#define SERVER_IO_BUFFER_SIZE 1000

#define SERVER_MAX_CLIENT_QUEUE CONFIG_NET_SAMPLE_NUM_HANDLERS

/********************************* TYPEDEFS ***********************************/
typedef int (*server_bind_t)(server_t *);
typedef int (*server_process_t)(server_t *);

typedef struct _server_iface_t {
    server_bind_t bind;
    server_process_t process;
} server_iface_t;
typedef server_iface_t *(*server_iface_create_t)(void);

struct _server_t
{
    server_proto_t type;
    int port;
    bool register_service;

    int sock;
    server_iface_t *iface;
};

/********************************* LOCAL DATA *********************************/


/******************************* LOCAL FUNCTIONS ******************************/
static int server_udp_bind(server_t *self)
{
    int ret = 0;
    static struct sockaddr_in s_addr;
    socklen_t s_addr_len = 0;

    if (self->type != SERVER_PROTO_UDP)
    {
        LOG_ERR("Invalid server context!");
        return -1;
    }

    (void)memset(&s_addr, 0, sizeof(s_addr));
    s_addr.sin_family = AF_INET;
    s_addr.sin_port = htons(self->port);

    if (self->register_service) {
        DNS_SD_REGISTER_SERVICE(esp32, CONFIG_NET_HOSTNAME,
                    "_esp32", "_udp", "local", DNS_SD_EMPTY_TXT,
                    &s_addr.sin_port);
    }

    self->sock = socket(s_addr.sin_family, SOCK_DGRAM, IPPROTO_UDP);
    if (self->sock < 0) {
        LOG_ERR("Failed to create UDP socket: %d, %s", errno, strerror(errno));
        ret = -errno;
    }

    if (0 == ret) {
        s_addr_len = sizeof(s_addr);
        ret = bind(self->sock, (struct sockaddr *)&s_addr, s_addr_len);
        if (ret < 0) {
            LOG_ERR("Failed to bind UDP socket: %d, %s", errno, strerror(errno));
            ret = -errno;
        }
    }

    return ret;
}

static int server_udp_process(server_t *self)
{
    int ret = 0;
    int received = 0;
    struct sockaddr client_addr;
    socklen_t client_addr_len;
    char recv_buffer[SERVER_IO_BUFFER_SIZE];

    if (self->type != SERVER_PROTO_UDP)
    {
        LOG_ERR("Invalid server context!");
        return -1;
    }

    LOG_INF("Listeing on UDP port %d...", self->port);
    for(;;)
    {
        client_addr_len = sizeof(client_addr);
        received = recvfrom(self->sock, recv_buffer,
                    SERVER_IO_BUFFER_SIZE, 0, &client_addr, &client_addr_len);
        if (received < 0) {
            /* Socket error */
            NET_ERR("UDP: Connection error: %d, %s", errno, strerror(errno));
            continue;
        }
        LOG_DBG("Received: %d bytes", received);

        ret = sendto(self->sock, recv_buffer, received, 0,
                 &client_addr, client_addr_len);
        if (ret < 0) {
            NET_ERR("UDP: Failed to send: %d, %s", errno, strerror(errno));
            continue;
        }
    }
}

static server_iface_t *server_udp_create(void)
{
    server_iface_t *udp = (server_iface_t *) k_malloc (sizeof (server_iface_t));
    udp->bind = server_udp_bind;
    udp->process = server_udp_process;

    return udp;
}

static int server_tcp_bind(server_t *self)
{
    int ret = 0;
    socklen_t s_addr_len = 0;
    static struct sockaddr_in s_addr;

    if (self->type != SERVER_PROTO_TCP)
    {
        LOG_ERR("Invalid server context!");
        return -1;
    }

    (void)memset(&s_addr, 0, sizeof(s_addr));
    s_addr.sin_family = AF_INET;
    s_addr.sin_port = htons(self->port);

    if (self->register_service) {
        DNS_SD_REGISTER_SERVICE(esp32, CONFIG_NET_HOSTNAME,
                    "_esp32", "_tcp", "local", DNS_SD_EMPTY_TXT,
                    &s_addr.sin_port);
    }

    self->sock = socket(s_addr.sin_family, SOCK_STREAM, 0);
    if (self->sock < 0) {
        LOG_ERR("Failed to create TCP socket: %d, %s", errno, strerror(errno));
        return -errno;
    }

    s_addr_len = sizeof(s_addr);
    ret = bind(self->sock, (struct sockaddr *)&s_addr, s_addr_len);
    if (ret < 0) {
        LOG_ERR("Failed to bind TCP socket: %d, %s", errno, strerror(errno));
        return -errno;
    }

    ret = listen(self->sock, SERVER_MAX_CLIENT_QUEUE);
    if (ret < 0) {
        LOG_ERR("Failed to listen on TCP socket: %d, %s", errno, strerror(errno));
        return -errno;
    }


    return 0;
}

static int server_tcp_conn_handler(server_t *self, int conn)
{
    int ret = 0;
    int received = 0;
    char recv_buffer[SERVER_IO_BUFFER_SIZE];

    for(;;)
    {
        received = recv(conn, recv_buffer, SERVER_IO_BUFFER_SIZE, 0);
        if (received == 0) {
            /* Connection closed */
            LOG_INF("TCP: Connection closed");
            break;
        } else if (received < 0) {
            /* Socket error */
            LOG_ERR("TCP: Connection error %d", errno);
            ret = errno;
            break;
        }
        send(conn, recv_buffer, received, 0);
    }

    (void)close(conn);
    return ret;
}

static int server_tcp_process(server_t *self)
{
    int conn = -1;
    struct sockaddr_in client_addr;
    socklen_t client_addr_len = 0;

    LOG_INF("Waiting for TCP connections on port %d...", self->port);
    client_addr_len = sizeof(client_addr);
    for (;;) {
        conn = accept(self->sock, (struct sockaddr *)&client_addr,
                &client_addr_len);
        if (conn < 0) {
            LOG_ERR("TCP: Accept error: %d, %s", errno, strerror(errno));
            continue;
        }

        server_tcp_conn_handler(self, conn);
    }

    return 0;
}

static server_iface_t *server_tcp_create(void)
{
    server_iface_t *tcp = (server_iface_t *) k_malloc (sizeof (server_iface_t));
    tcp->bind = server_tcp_bind;
    tcp->process = server_tcp_process;

    return tcp;
}

static server_iface_create_t server_iface_create[SERVER_PROTO_N] = {
    server_udp_create,
    server_tcp_create,
};

/***************************** INTERFACE FUNCTIONS ****************************/
server_t *server_new (server_proto_t type, int port, bool register_service)
{
    LOG_INF("Creating new server object");

    server_t *self = (server_t *) k_malloc (sizeof (server_t));
    assert (self);
    self->type = type;
    self->port = port;
    self->register_service = register_service;
    self->iface = server_iface_create[type]();

    return self;
}

void server_destroy (server_t **self_p)
{
    assert (self_p);
    if (*self_p) {
        server_t *self = *self_p;
        //  Free class properties here
        //  Free object itself
        k_free(self->iface);
        k_free (self);
        *self_p = NULL;
    }
}

void server_start (void *p1, void *p2, void *p3)
{
    int ret = 0;
    server_t *self = (server_t *)p1;

    ret = self->iface->bind(self);
    if (0 != ret)
    {
        LOG_ERR("Bind Failed!");
        return;
    }

    self->iface->process(self);
}
```

## src/server.h
```c
/******************************** INCLUDE FILES *******************************/
#include <stdbool.h>
/******************************** LOCAL DEFINES *******************************/

/********************************* TYPEDEFS ***********************************/
typedef struct _server_t server_t;

typedef enum _server_proto_t
{
    SERVER_PROTO_UDP = 0,
    SERVER_PROTO_TCP,
    SERVER_PROTO_N
} server_proto_t;

/***************************** INTERFACE FUNCTIONS ****************************/
server_t *server_new (server_proto_t type, int port, bool register_service);
void server_destroy (server_t **self_p);
void server_start (void *p1, void *p2, void *p3);
```

## src/version.h
```c
/******************************** INCLUDE FILES *******************************/
#include <zephyr/kernel.h>

#include "git.h"
/********************************** DEFINES ***********************************/
#define APP_VERSION_MAJOR 0
#define APP_VERSION_MINOR 1
#define APP_VERSION_PATCH 0

#define APP_MAKE_VERSION(major, minor, patch) \
    ((major) * 10000 + (minor) * 100 + (patch))
#define APP_VERSION \
    APP_MAKE_VERSION(APP_VERSION_MAJOR, APP_VERSION_MINOR, APP_VERSION_PATCH)

/********************************* TYPEDEFS ***********************************/

/***************************** INTERFACE FUNCTIONS ****************************/
static inline void version_print(void)
{
    printk("*** Application %s-v%d.%d.%d-%s-%s %s ***\n", __APP_NAME__, APP_VERSION_MAJOR,
     APP_VERSION_MINOR, APP_VERSION_PATCH, git_Branch(), git_CommitSHA1(), git_CommitDate());
}
```

## src/wifi.c
```c
/******************************** INCLUDE FILES *******************************/
#include <zephyr/net/net_if.h>
#include <zephyr/net/wifi_mgmt.h>
#include <zephyr/net/net_event.h>
#include <zephyr/logging/log.h>

#include "wifi.h"
/******************************** LOCAL DEFINES *******************************/
LOG_MODULE_REGISTER(wifi, LOG_LEVEL_DBG);

/********************************* TYPEDEFS ***********************************/
typedef struct _wifi_ctx_t {
    /* Private */
    struct net_if *iface;
    struct net_mgmt_event_callback event_cb;
    struct wifi_connect_req_params params;
    struct k_sem connected;
} wifi_ctx_t;

/********************************* LOCAL DATA *********************************/
static wifi_ctx_t wifi;
static wifi_iface_t wifi_iface;

/******************************* LOCAL FUNCTIONS ******************************/

/* WIFI Event handler */
static void wifi_connect_event_handler(struct net_mgmt_event_callback *cb) {
    const struct wifi_status *info = (const struct wifi_status *)cb->info;

    if (info->status) {
        LOG_ERR("Connection request failed (%d)", info->status);
    } else {
        LOG_INF("Connected");
        k_sem_give(&wifi.connected);
    }
}

static void wifi_disconnect_event_handler(struct net_mgmt_event_callback *cb) {
    const struct wifi_status *info = (const struct wifi_status *)cb->info;

    if (info->status) {
        LOG_ERR("Disconnection request (%d)", info->status);
    } else {
        LOG_INF("Disconnected");
        k_sem_take(&wifi.connected, K_NO_WAIT);
    }
}

static void wifi_mgmt_event_handler(struct net_mgmt_event_callback *cb,
    uint32_t wifi_mgmt_event, struct net_if *iface) {
    switch (wifi_mgmt_event) {
    case NET_EVENT_WIFI_CONNECT_RESULT:
        wifi_connect_event_handler(cb);
        break;
    case NET_EVENT_WIFI_DISCONNECT_RESULT:
        wifi_disconnect_event_handler(cb);
        break;
    default:
        break;
    }
}

static bool wifi_connect(const char *ssid, char *pass) {
    int retries = 3;
    bool net_iface_up = false;

    k_sem_init (&wifi.connected, 0, 1);
    wifi.iface = net_if_get_default();
    /* Check if the network interface is up */
    while (retries) {
        net_iface_up = net_if_is_up(wifi.iface);
        if (net_iface_up)
            break;

        k_sleep(K_MSEC(100));
        retries--;
    }

    if (!net_iface_up)
        return false;

    net_mgmt_init_event_callback(&wifi.event_cb, wifi_mgmt_event_handler,
        NET_EVENT_WIFI_CONNECT_RESULT | NET_EVENT_WIFI_DISCONNECT_RESULT);
    net_mgmt_add_event_callback(&wifi.event_cb);

    memset(&wifi.params, 0x00, sizeof(struct wifi_connect_req_params));
    /* Connect to WIFI */
    wifi.params.ssid = ssid;
    wifi.params.psk = pass;
    wifi.params.ssid_length = strlen(ssid);
    wifi.params.psk_length = strlen(pass);
    wifi.params.channel = WIFI_CHANNEL_ANY;
    wifi.params.security = WIFI_SECURITY_TYPE_PSK;
    wifi.params.band = WIFI_FREQ_BAND_2_4_GHZ;
    wifi.params.mfp = WIFI_MFP_OPTIONAL;

    LOG_INF("Connecting to: %s", wifi.params.ssid);
    if (net_mgmt(NET_REQUEST_WIFI_CONNECT, wifi.iface,
        &wifi.params, sizeof(struct wifi_connect_req_params))) {
        LOG_ERR("WiFi Connection Request Failed");
        return false;
    }
    LOG_INF("Waiting for authorization...");
    k_sem_take(&wifi.connected, K_FOREVER);

    return true;
}

static void wifi_disconnect(void) {
    if (net_mgmt(NET_REQUEST_WIFI_DISCONNECT, wifi.iface, NULL, 0))
    {
        LOG_ERR("WiFi Disconnection Request Failed");
    }
}

static void wifi_status(void) {
    struct wifi_iface_status status = {0};

    if (net_mgmt(NET_REQUEST_WIFI_IFACE_STATUS, wifi.iface, &status,
        sizeof(struct wifi_iface_status))) {
        LOG_ERR("WiFi Status Request Failed");
    }

    if (status.state >= WIFI_STATE_ASSOCIATED) {
        LOG_INF("Wifi network state:");
        LOG_INF("\tSSID: %-32s", status.ssid);
        LOG_INF("\tBand: %s", wifi_band_txt(status.band));
        LOG_INF("\tChannel: %d", status.channel);
        LOG_INF("\tSecurity: %s", wifi_security_txt(status.security));
        LOG_INF("\tRSSI: %d", status.rssi);
    }
}

/***************************** INTERFACE FUNCTIONS ****************************/
wifi_iface_t *wifi_get(void) {
    wifi_iface.connect = wifi_connect;
    wifi_iface.disconnect = wifi_disconnect;
    wifi_iface.status = wifi_status;

    return &wifi_iface;
}
```

## src/wifi.h
```c
/******************************** INCLUDE FILES *******************************/
#include <stdbool.h>
/********************************** DEFINES ***********************************/

/********************************* TYPEDEFS ***********************************/
typedef bool (*wifi_connect_t) (const char *, char *);
typedef void (*wifi_disconnect_t) (void);
typedef void (*wifi_status_t) (void);

typedef struct _wifi_iface_t {
    wifi_connect_t connect;
    wifi_disconnect_t disconnect;
    wifi_status_t status;
} wifi_iface_t;

/***************************** INTERFACE FUNCTIONS ****************************/
wifi_iface_t *wifi_get(void);
```
