## CMakeLists.txt
```
# SPDX-License-Identifier: Apache-2.0

# Default board
set(BOARD esp32s3_devkitm/esp32s3/procpu)

cmake_minimum_required(VERSION 3.20.0)

find_package(Zephyr REQUIRED HINTS $ENV{ZEPHYR_BASE})
project(exercise)

FILE(GLOB app_sources src/*.c)
target_sources(app PRIVATE ${app_sources})
zephyr_include_directories(config)

# Generate a git hash that's used as part of the software_version, eg
# 1.0.0+12345678. Permit overriding at command line for CI builds.
if (NOT DEFINED ZEPHYR_MEMFAULT_EXAMPLE_GIT_SHA1)
  EXECUTE_PROCESS(
    WORKING_DIRECTORY ${CMAKE_CURRENT_SOURCE_DIR}
    COMMAND git rev-parse --short HEAD
    RESULT_VARIABLE commit_sha1
    OUTPUT_VARIABLE ZEPHYR_MEMFAULT_EXAMPLE_GIT_SHA1
    OUTPUT_STRIP_TRAILING_WHITESPACE
    COMMAND_ERROR_IS_FATAL ANY
  )
endif()
```

## Kconfig
```
# Application Kconfig file
#
# This is loaded when building this directory with west.
menu "Exercise Application Configuration"

config EXERCISE_SOFTWARE_VERSION
    string "Software Version"
    default "1.0.0"
    help
      The software version.

endmenu

source "Kconfig.zephyr"
```

## sample.yaml
```
common:
  harness: net
  tags:
    - net
    - wifi
sample:
  description: Test wifi driver and APIs functionality
  name: WiFi sample app
tests:
  sample.net.wifi:
    platform_allow:
      - cc3220sf_launchxl
      - disco_l475_iot1
      - reel_board
    integration_platforms:
      - cc3220sf_launchxl
  sample.net.wifi.mikroe_wifi_bt_click:
    extra_args: SHIELD=mikroe_wifi_bt_click_mikrobus
    platform_allow: lpcxpresso55s69_cpu0
  sample.net.wifi.esp_8266:
    extra_args: SHIELD=esp_8266
    platform_allow: sam4e_xpro
  sample.net.wifi.esp_8266_arduino:
    extra_args: SHIELD=esp_8266_arduino
    platform_allow:
      - frdm_k64f
      - disco_l475_iot1
    integration_platforms:
      - frdm_k64f
  sample.net.wifi.inventek_eswifi_arduino_uart:
    extra_args: SHIELD=inventek_eswifi_arduino_uart
    platform_allow:
      - frdm_k64f
      - nucleo_f767zi
    integration_platforms:
      - frdm_k64f
  sample.net.wifi.inventek_eswifi_arduino_spi:
    extra_args: SHIELD=inventek_eswifi_arduino_spi
    platform_allow:
      - frdm_k64f
      - nucleo_f767zi
    integration_platforms:
      - frdm_k64f
```

## prj.conf
```kconfig
CONFIG_EARLY_CONSOLE=y
CONFIG_SHELL=y

CONFIG_NETWORKING=y
# Use the testing RNG. This is NOT suitable for production use. Some devices do
# not have a built-in RNG in Zephyr upstream, so this is convenient for testing.
# CONFIG_TEST_RANDOM_GENERATOR=y

CONFIG_NET_TX_STACK_SIZE=2048
CONFIG_NET_RX_STACK_SIZE=2048

CONFIG_NET_PKT_RX_COUNT=10
CONFIG_NET_PKT_TX_COUNT=10
CONFIG_NET_BUF_RX_COUNT=32
CONFIG_NET_BUF_TX_COUNT=32
CONFIG_NET_BUF_DATA_SIZE=256
CONFIG_NET_DEBUG_NET_PKT_ALLOC=y
CONFIG_MEM_SLAB_TRACE_MAX_UTILIZATION=y

# Network protocols
CONFIG_NET_DHCPV4=y

CONFIG_NET_IPV4=y
CONFIG_NET_IPV6=n

CONFIG_NET_TCP=y

CONFIG_NET_LOG=y
CONFIG_INIT_STACKS=y

CONFIG_NET_SHELL=y

CONFIG_NET_STATISTICS=y
CONFIG_NET_STATISTICS_PERIODIC_OUTPUT=n

CONFIG_WIFI=y
CONFIG_WIFI_LOG_LEVEL_ERR=y
CONFIG_NET_L2_WIFI_SHELL=y

CONFIG_NET_L2_ETHERNET=y
CONFIG_ESP32_WIFI_STA_AUTO_DHCPV4=y

# Memfault configuration
CONFIG_MEMFAULT=y
CONFIG_MEMFAULT_LOGGING_ENABLE=y
CONFIG_MEMFAULT_HTTP_ENABLE=y
CONFIG_MEMFAULT_HTTP_PERIODIC_UPLOAD=y

# Additional network configuration for Memfault features
CONFIG_DNS_RESOLVER=y
CONFIG_POSIX_API=y
CONFIG_NET_SOCKETS=y
CONFIG_TLS_CREDENTIALS=y
CONFIG_NET_SOCKETS_SOCKOPT_TLS=y
CONFIG_NET_STATISTICS=y
CONFIG_NET_STATISTICS_USER_API=y

# MbedTLS config
CONFIG_MBEDTLS_SHA1=y
CONFIG_MBEDTLS_SERVER_NAME_INDICATION=y
CONFIG_MBEDTLS_ENABLE_HEAP=y
CONFIG_MBEDTLS_HEAP_SIZE=30000
CONFIG_MBEDTLS_SSL_MAX_CONTENT_LEN=4096
CONFIG_MBEDTLS_MEMORY_DEBUG=y
CONFIG_MBEDTLS_SHELL=y
CONFIG_MBEDTLS_AES_ROM_TABLES=y

# Credential shell, useful for debug
CONFIG_TLS_CREDENTIALS_SHELL=y
# Required for TLS crediential shell
CONFIG_BASE64=y

# More verbose Memfault component logs
CONFIG_MEMFAULT_LOG_LEVEL_DBG=y

# Don't log printk() statements, they're meant for raw output to the console.
CONFIG_LOG_PRINTK=n

CONFIG_LOG_MODE_IMMEDIATE=y

# Disable these temporarily, for debugging.
CONFIG_MEMFAULT_COREDUMP_COLLECT_DATA_REGIONS=y
CONFIG_MEMFAULT_COREDUMP_COLLECT_KERNEL_REGION=n
CONFIG_MEMFAULT_COREDUMP_COLLECT_TASKS_REGIONS=n

# Memfault's http client needs a small amount of heap. Zephyr requires a minimum
# heap size for the applied configuration, so select that here to prevent a
# build time message
CONFIG_HEAP_MEM_POOL_SIZE=52224
CONFIG_SYS_HEAP_RUNTIME_STATS=y
CONFIG_SHELL_STACK_SIZE=4096
CONFIG_SYSTEM_WORKQUEUE_STACK_SIZE=2048

# hwinfo is used for a unique device id
CONFIG_HWINFO=y

CONFIG_ASSERT=y

# Enable MCUboot
CONFIG_BOOTLOADER_MCUBOOT=y
CONFIG_MCUBOOT_SHELL=y
CONFIG_MCUBOOT_IMG_MANAGER=y
CONFIG_IMG_MANAGER=y
CONFIG_FLASH=y
CONFIG_FLASH_PAGE_LAYOUT=y
CONFIG_FLASH_MAP=y
CONFIG_STREAM_FLASH=y

# For cpu_temp metric
CONFIG_SENSOR=y
CONFIG_ADC=y
```

## src/main.c
```c
#include <string.h>
#include <zephyr/drivers/hwinfo.h>
#include <zephyr/kernel.h>
#include <zephyr/logging/log.h>

LOG_MODULE_REGISTER(main, LOG_LEVEL_DBG);

void main(void)
{
    char *board_name = hwinfo_get_board_name();
    LOG_INF("Board name: %s", board_name);
}
```
